#include <dt-bindings/zmk/matrix_transform.h>

// / {
//     matrix-transform {
//         compatible = "zmk,matrix-transform";
//         rows = <3>;
//         columns = <4>;
//         map = <
//             RC(0,0) RC(0,1) RC(0,2) RC(0,3)
//             RC(1,0) RC(1,1) RC(1,2) RC(1,3)
//             RC(2,0) RC(2,1) RC(2,2) RC(2,3)
//         >;
//     };
// };

/ {
    chosen {
        zmk,kscan = &kscan0;
    };

    kscan0: kscan {
        compatible = "zmk,kscan-gpio-matrix";
        wakeup-source;

        diode-direction = "col2row";

        row-gpios
            = <&gpio0 18 (GPIO_ACTIVE_HIGH | GPIO_PULL_DOWN)>
            , <&gpio0 19 (GPIO_ACTIVE_HIGH | GPIO_PULL_DOWN)>
            , <&gpio0 20 (GPIO_ACTIVE_HIGH | GPIO_PULL_DOWN)>
            ;

        col-gpios
            = <&gpio0 10 GPIO_ACTIVE_HIGH>
            , <&gpio0 16 GPIO_ACTIVE_HIGH>
            , <&gpio0 14 GPIO_ACTIVE_HIGH>
            , <&gpio0 15 GPIO_ACTIVE_HIGH>
            ;

        debounce-press-ms = <5>;
        debounce-release-ms = <5>;
    };
};