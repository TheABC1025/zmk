## app/boards/arm/mdbt50q_1m/Kconfig.defconfig
```kconfig
if BOARD_MDBT50Q_1M

config BOARD
    default "mdbt50q_1m"

if USB_DEVICE_STACK

config USB_NRFX
    default y

endif # USB_DEVICE_STACK

config BT_CTLR
    default BT

endif # BOARD_MDBT50Q_1M
```

## app/boards/arm/mdbt50q_1m/mdbt50q_1m_defconfig
```kconfig
# Copyright (c) 2020 The ZMK Contributors
# SPDX-License-Identifier: MIT

CONFIG_SOC_SERIES_NRF52X=y
CONFIG_SOC_NRF52840_QIAA=y
CONFIG_BOARD_MDBT50Q_1M=y

# Enable MPU
CONFIG_ARM_MPU=y

# enable GPIO
CONFIG_GPIO=y

CONFIG_USE_DT_CODE_PARTITION=y
CONFIG_BUILD_OUTPUT_UF2=y

CONFIG_MPU_ALLOW_FLASH_WRITE=y
CONFIG_NVS=y
CONFIG_SETTINGS_NVS=y
CONFIG_FLASH=y
CONFIG_FLASH_PAGE_LAYOUT=y
CONFIG_FLASH_MAP=y

CONFIG_ZMK_USB=y
CONFIG_ZMK_BLE=y

# For debug log
# ログ機能を有効化
CONFIG_LOG=y
CONFIG_LOG_DEFAULT_LEVEL=4
CONFIG_LOG_PROCESS_THREAD=y
CONFIG_LOG_MODE_DEFERRED=y

CONFIG_CONSOLE=y

# UARTログを有効化
CONFIG_SERIAL=y
CONFIG_LOG_BACKEND_UART=y
CONFIG_UART_CONSOLE=y
CONFIG_PRINTK=y
```

## app/boards/shields/plume/Kconfig.shield
```kconfig
config SHIELD_PLUME_LEFT
    def_bool $(shields_list_contains,plume_left)

config SHIELD_PLUME_RIGHT
    def_bool $(shields_list_contains,plume_right)
```
