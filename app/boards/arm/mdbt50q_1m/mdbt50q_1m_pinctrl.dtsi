&pinctrl {
    uart0_default: uart0_default {
        // group1 {
        //         psels = <NRF_PSEL(UART_TX, 0, 6)>, // TX ピン
        //                 <NRF_PSEL(UART_RX, 0, 8)>; // RX ピン
        //     };
        group1 {
            psels = <NRF_PSEL(UART_RX, 0, 8)>;
            bias-pull-up;
        };
        group2 {
            psels = <NRF_PSEL(UART_TX, 0, 6)>;
        };
    };
};